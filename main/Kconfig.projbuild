## main/Kconfig.projbuild
```kconfig
menu "NFC alarm clock"
    config CLOCK_DEVELOPMENT_BUILD
        bool "Development build (never deploy as production)"
        default n
    config CLOCK_SIMULATED_NFC
        bool "Allow simulated NFC and RAM-only alarm demo (development only)"
        depends on CLOCK_DEVELOPMENT_BUILD
        default n
endmenu
```

## sdkconfig.defaults
```kconfig
CONFIG_IDF_TARGET="esp32s3"
CONFIG_ESPTOOLPY_OCT_FLASH=y
CONFIG_ESPTOOLPY_FLASHMODE_OPI=y
CONFIG_ESPTOOLPY_FLASH_SAMPLE_MODE_DTR=y
CONFIG_ESPTOOLPY_FLASHFREQ_80M=y
CONFIG_ESPTOOLPY_FLASHSIZE_32MB=y
CONFIG_SPIRAM=y
CONFIG_SPIRAM_MODE_OCT=y
CONFIG_SPIRAM_SPEED_80M=y
CONFIG_SPIRAM_MEMTEST=y
CONFIG_SPIRAM_IGNORE_NOTFOUND=y
CONFIG_PARTITION_TABLE_CUSTOM=y
CONFIG_PARTITION_TABLE_CUSTOM_FILENAME="partitions.csv"
CONFIG_ESP_CONSOLE_UART_DEFAULT=y
CONFIG_LOG_DEFAULT_LEVEL_INFO=y
# CONFIG_CLOCK_DEVELOPMENT_BUILD is not set
# CONFIG_CLOCK_SIMULATED_NFC is not set
```
